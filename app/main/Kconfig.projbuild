## app/main/Kconfig.projbuild
```kconfig
menu "JC player app"
config APP_TEST_PANIC
    bool "Test: abort() 5 s after boot (boot-loop guard check)"
    default n
config APP_TEST_NO_SD
    bool "Test: behave as if the TF card is missing"
    default n
config APP_TEST_PLAY
    bool "Test: play the first MP3 under /sdcard/export at boot"
    default n
config APP_TEST_SLEEP_SHORT
    bool "Test: sleep timer counts seconds instead of minutes"
    default n
endmenu
```

## tools/bench/aptx_bench/sdkconfig.defaults
```kconfig
CONFIG_ESP_MAIN_TASK_STACK_SIZE=32768
CONFIG_FREERTOS_HZ=1000
CONFIG_COMPILER_OPTIMIZATION_PERF=y
CONFIG_SPIRAM=y
CONFIG_ESP_DEFAULT_CPU_FREQ_MHZ_320=y
```

## tools/bench/lc3_bench/sdkconfig.defaults
```kconfig
CONFIG_ESP_MAIN_TASK_STACK_SIZE=16384
CONFIG_FREERTOS_HZ=1000
CONFIG_COMPILER_OPTIMIZATION_PERF=y
CONFIG_ESP_DEFAULT_CPU_FREQ_MHZ_320=y
CONFIG_ESP_TASK_WDT_INIT=n
```

## tools/bt_peer/avrc_peer/main/Kconfig.projbuild
```kconfig
menu "AVRCP Bench Peer Configuration"
    config EXAMPLE_LOCAL_DEVICE_NAME
        string "Local Device Name"
        default "JC Peer AVRC"
        help
            Use this option to set local device name.
endmenu
```
